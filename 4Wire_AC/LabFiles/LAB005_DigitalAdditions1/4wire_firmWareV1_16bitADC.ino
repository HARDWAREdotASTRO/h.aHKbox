/*
   4-wire Firmware
   WAG _ Project H.aHK Box _ 4-wire AC Daugter Card
   Version 1.1
   S. Shaw
   2/13/2022

   Outputs a sine wave with user defined frequency to Teensy DAC hardware
   Calculates and outputs an RMS Voltage value at a user defined Read_Out_Rate
*/

// User Inputs
float freq_sin = 10; // Frequency of Sine Wave Modulation (Hz), [1, 160] range allowed given Nyquist sampling rate of 2 samples per period, 320 max SPS of ADC
int Num_Cycles = 10; // integer used for # of cycles per read window or the Read Out Rate.

// preset/calcuated values
float rms_sum, tim; //rms sum for RMS calculations, tim for outputting sinwave based on time
int frame; //integer used to keep track of what frame in a given window the current reading is
float period = 1 / freq_sin; // Calculate period of sine wave
int window_length = (period * Num_Cycles) / 0.0061; //integer calculated to provide the # of frames, or readings, that will be used per RMS calculation (SPS/Read Out Rate)
float twopi = 3.14159 * 2; //For sin wave generation
int tim_old = 0;

// Imports ADC library and defines hardware-to-software definition for library
#include<ADS1115_WE.h>
#include<Wire.h>
#define I2C_ADDRESS 0x48
ADS1115_WE adc = ADS1115_WE(I2C_ADDRESS);


void setup() {
  analogWriteResolution(12); //Define DAC output pin for sin wave generation
  Wire.begin();
  Serial.begin(115200); //Begin serial comm for debug
  while ( !Serial ) ; //Wait for serial comm to initialize
  // Error handling if ADC not found. Might need to run nauStartupCode or check wiring
  if (!adc.init()) {
    Serial.println("ADS1115 not connected!");
  }

  // Define ADC settings
  adc.setVoltageRange_mV(ADS1115_RANGE_4096); //comment line/change parameter to change range
  adc.setCompareChannels(ADS1115_COMP_0_GND); //comment line/change parameter to change channel
  adc.setConvRate(ADS1115_860_SPS); //uncomment if you want to change the default
  adc.setMeasureMode(ADS1115_CONTINUOUS); //comment line/change parameter to change mode

  // set dynamic variable starting values
  rms_sum = 0;
  frame = 1;
  Serial.println("");
  Serial.println(window_length);
  Serial.println("Window Length ^^");
  Serial.println("");
}






void loop() {

  /*
    // prototype code: delay until we are at wave peak
    tim = micros(); //Calculate microseconds
    // If current time is not lined up approximatly at 1/4 the sine wave, or with the first peak of a cycle, delay until alligned
    if ((int(tim) % int(period * 1000000)) > (period * 250100) | (int(tim) % int(period * 1000000)) < (period * 249900)) {
      delayMicroseconds(int(period * 1000000) - (int(tim) % int(period * 1000000)) + period * 250000);
      //Serial.print("Wait!!!!");
    }
    //tim = micros();
    //Serial.println(int(tim) % int(period * 1000000));
  */

  tim = micros() / 1000000.0; //Calculate Seconds
  Sin(freq_sin, tim, period); // Run next sinwave output voltage level based on frequency and time
  if ((tim * 1000000) - tim_old >= 6100) //trying to get to 6100 microseconds or 6.100 millis between readings
  {
    if (frame <= window_length)
    {
      rms_sum = rms_sum + sq(readChannel(ADS1115_COMP_0_GND));
      frame = frame + 1; // Update frame # for next ADC measurement
      //Serial.println(tim, 6);
      //Serial.println((nau.read() / 8388608.0) * 2.5);
    }

    else if (frame > window_length) {
      //Calculate final RMS value and output
      float rms_volt = sqrt(rms_sum / window_length);
      Serial.println("RMS_Voltage");
      Serial.println("");
      Serial.println(rms_volt, 6);
      Serial.println("");
      //Serial.print(tim, 7);
      //Serial.println("");

      rms_sum = 0;
      frame = 1; //reinitialize frame integer to 0 for next window of measurements/ next RMS value
    }
    tim_old = micros();
  }

}



float readChannel(ADS1115_MUX channel) {
  float voltage = 0.0;
  adc.setCompareChannels(channel);
  voltage = adc.getResult_V(); // alternative: getResult_mV for Millivolt
  return voltage;
}



// Sine Wave Generator Code function: Uses a table of 1024 sine wave values from [0, 1] as ratios for computing correct DAC output.

void Sin(float freq_m, float tim, float period) {
  //Full resolution is 4095, over 3.3 V -> 0.00080586 V per bit
  // Currently set to 500mV amplitude, 2V offset

  float window_tim = int(tim * 100000) % int(period * 100000); // window time in us
  float sin_values[] = {0.000000, 0.006142, 0.012284, 0.018425, 0.024565, 0.030705, 0.036843, 0.042980, 0.049116, 0.055249, 0.061381, 0.067510, 0.073636, 0.079760, 0.085881, 0.091999, 0.098113,
                        0.104223, 0.110330, 0.116432, 0.122530, 0.128623, 0.134712, 0.140795, 0.146873, 0.152946, 0.159012, 0.165073, 0.171128, 0.177176, 0.183217, 0.189251, 0.195279,
                        0.201299, 0.207311, 0.213316, 0.219312, 0.225300, 0.231280, 0.237251, 0.243213, 0.249166, 0.255110, 0.261043, 0.266967, 0.272881, 0.278785, 0.284678, 0.290561,
                        0.296432, 0.302292, 0.308141, 0.313978, 0.319804, 0.325617, 0.331418, 0.337206, 0.342982, 0.348745, 0.354495, 0.360231, 0.365954, 0.371663, 0.377358, 0.383039,
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                        -0.085881, -0.079760, -0.073636, -0.067510, -0.061381, -0.055249, -0.049116, -0.042980, -0.036843, -0.030705, -0.024565, -0.018425, -0.012284, -0.006142, 0.000000
                       };

  float valWrite = sin_values[int(1024 * (window_tim / (period * 100000)))]  * 620.0 + 2481.0;
  analogWrite(A14, (int)valWrite);
}
